## prj.conf
```kconfig
CONFIG_TEST=y
CONFIG_CONSOLE_HANDLER=y
CONFIG_USERSPACE=n
CONFIG_NO_OPTIMIZATIONS=y

CONFIG_BT=y
CONFIG_BT_CENTRAL=y
CONFIG_BT_PERIPHERAL=y
CONFIG_BT_GATT_CLIENT=y
CONFIG_BT_DEVICE_NAME="bsim_test_audio"
# Needed to test BASS
CONFIG_BT_PER_ADV=y
CONFIG_BT_EXT_ADV_LEGACY_SUPPORT=y

CONFIG_BT_AUDIO=y
CONFIG_BT_AUDIO_UNICAST=y

# Coordinated Set Identification
CONFIG_BT_CSIS=y
CONFIG_BT_CSIP=y

# Broadcast Audio Scan Service and client
CONFIG_BT_BASS=y
CONFIG_BT_BASS_CLIENT=y

# Volume Offset Control Service
CONFIG_BT_VOCS_MAX_INSTANCE_COUNT=1

# Audio Input Control Service
CONFIG_BT_AICS_MAX_INSTANCE_COUNT=2
CONFIG_BT_AICS_CLIENT_MAX_INSTANCE_COUNT=2

# Call control and telephone bearer
CONFIG_BT_TBS=y
CONFIG_BT_TBS_SUPPORTED_FEATURES=3
CONFIG_BT_TBS_TECHNOLOGY=1
CONFIG_BT_TBS_STATUS_FLAGS=3
CONFIG_BT_CCP=y
CONFIG_BT_CCP_MAX_CALLS=2

# DEBUGGING
CONFIG_BT_DEBUG_LOG=y
CONFIG_BT_AUDIO_DEBUG=y
CONFIG_BT_DEBUG_CSIS=y
CONFIG_BT_DEBUG_CSIP=y
CONFIG_BT_DEBUG_TBS=y
CONFIG_BT_DEBUG_CCP=y

# LOGGING
CONFIG_TEST_LOGGING_DEFAULTS=n
CONFIG_LOG_IMMEDIATE=y
```

## src/main.c
```c
/*
 * Copyright (c) 2020 Nordic Semiconductor ASA
 *
 * SPDX-License-Identifier: Apache-2.0
 */

#include "bstests.h"

bst_test_install_t test_installers[] = {
	NULL
};

void main(void)
{
	bst_main();
}
```

## src/common.c
```c
/*
 * Copyright (c) 2019 Bose Corporation
 *
 * SPDX-License-Identifier: Apache-2.0
 */

#ifdef CONFIG_BT_TBS
#include "../../../../../subsys/bluetooth/host/audio/tbs.h"
#include "../../../../../subsys/bluetooth/host/audio/ccp.h"
#include "common.h"

extern enum bst_result_t bst_result;
struct bt_conn *default_conn;

const struct bt_data ad[] = {
	BT_DATA_BYTES(BT_DATA_FLAGS, (BT_LE_AD_GENERAL | BT_LE_AD_NO_BREDR))
};

void device_found(const bt_addr_le_t *addr, int8_t rssi, uint8_t type,
			 struct net_buf_simple *ad)
{
	char addr_str[BT_ADDR_LE_STR_LEN];
	int err;

	if (default_conn) {
		return;
	}

	/* We're only interested in connectable events */
	if (type != BT_HCI_ADV_IND && type != BT_HCI_ADV_DIRECT_IND) {
		return;
	}

	bt_addr_le_to_str(addr, addr_str, sizeof(addr_str));
	printk("Device found: %s (RSSI %d)\n", addr_str, rssi);

	/* connect only to devices in close proximity */
	if (rssi < -70) {
		FAIL("RSSI too low");
		return;
	}

	printk("Stopping scan\n");
	if (bt_le_scan_stop()) {
		FAIL("Could not stop scan");
		return;
	}

	err = bt_conn_le_create(addr, BT_CONN_LE_CREATE_CONN,
				BT_LE_CONN_PARAM_DEFAULT, &default_conn);
	if (err) {
		FAIL("Could not connect to peer: %d", err);
	}
}

void disconnected(struct bt_conn *conn, uint8_t reason)
{
	char addr[BT_ADDR_LE_STR_LEN];

	if (conn != default_conn) {
		return;
	}

	bt_addr_le_to_str(bt_conn_get_dst(conn), addr, sizeof(addr));

	printk("Disconnected: %s (reason %u)\n", addr, reason);

	bt_conn_unref(default_conn);
	default_conn = NULL;
}

struct bt_conn_cb conn_callbacks = {
	.disconnected = disconnected,
};

void test_tick(bs_time_t HW_device_time)
{
	if (bst_result != Passed) {
		FAIL("test failed (not passed after %i seconds)\n", WAIT_TIME);
	}
}

void test_init(void)
{
	bst_ticker_set_next_tick_absolute(WAIT_TIME);
	bst_result = In_progress;
}

#endif /* CONFIG_BT_TBS */
```

## src/common.h
```c
/**
 * Common functions and helpers for BSIM audio tests
 *
 * Copyright (c) 2019 Bose Corporation
 *
 * SPDX-License-Identifier: Apache-2.0
 */

#ifndef ZEPHYR_TEST_BSIM_BT_AUDIO_TEST_
#define ZEPHYR_TEST_BSIM_BT_AUDIO_TEST_

#include "kernel.h"

#include "bs_types.h"
#include "bs_tracing.h"
#include "time_machine.h"
#include "bstests.h"

#include <zephyr/types.h>
#include <stddef.h>
#include <errno.h>
#include <zephyr.h>

#include <bluetooth/bluetooth.h>
#include <bluetooth/hci.h>
#include <bluetooth/conn.h>
#include <bluetooth/uuid.h>
#include <bluetooth/gatt.h>

#define WAIT_TIME (30 * 1e6) /*seconds*/

#define WAIT_FOR(cond) while (!(cond)) { k_sleep(K_MSEC(1)); }

#define FAIL(...)							\
	do {								\
		bst_result = Failed;					\
		bs_trace_error_time_line(__VA_ARGS__);			\
	} while (0)

#define PASS(...)							\
	do {								\
		passes++;						\
		printk("Passes %u/%u\n", passes, expected_passes);	\
		if (passes == expected_passes) {			\
			bst_result = Passed;				\
		}							\
		bs_trace_info_time(1, __VA_ARGS__);			\
	} while (0)

#define SET_STEP(s)							\
	do {								\
		if (s == step + 1) {					\
			step = s;					\
			printk("Step %u\n", step);			\
		} else {						\
			FAIL("Invalid step %u (expected %u)", s, step + 1); \
		}							\
	} while (0)

extern const struct bt_data ad[];

void device_found(const bt_addr_le_t *addr, int8_t rssi, uint8_t type,
		  struct net_buf_simple *ad);
void disconnected(struct bt_conn *conn, uint8_t reason);
void test_tick(bs_time_t HW_device_time);
void test_init(void);

#endif /* ZEPHYR_TEST_BSIM_BT_AUDIO_TEST_ */
```
